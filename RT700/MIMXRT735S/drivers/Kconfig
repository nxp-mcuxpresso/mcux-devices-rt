## RT700/MIMXRT735S/drivers/Kconfig
```kconfig
# Copyright 2024 NXP
# All rights reserved.
#
# SPDX-License-Identifier: BSD-3-Clause

menu "Device specific drivers configuration"

    config MCUX_COMPONENT_driver.clock
         bool "Use driver clock"
         default y

    config MCUX_COMPONENT_driver.dsp
         bool "Use driver dsp"
         depends on MCUX_HW_CORE_CM33

    config MCUX_COMPONENT_driver.edma_soc
         bool "Use driver edma_soc"

    config MCUX_COMPONENT_driver.ezhv
         bool "Use driver ezhv"
	 depends on MCUX_HW_CORE_CM33

    config MCUX_COMPONENT_driver.inputmux_connections
         bool "Use driver inputmux_connections"

    config MCUX_COMPONENT_driver.iopctl_soc
         bool "Use driver iopctl"
         default y

    config MCUX_COMPONENT_driver.power
         bool "Use driver power"
         depends on MCUX_HW_CORE_CM33

    config MCUX_COMPONENT_driver.reset
         bool "Use driver reset"
         default y

    config MCUX_COMPONENT_driver.romapi
         bool "Use driver romapi"
         depends on MCUX_HW_CORE_ID_CM33_CORE0
endmenu
```

## RT700/MIMXRT798S/drivers/Kconfig
```kconfig
# Copyright 2024-2025 NXP
#
# SPDX-License-Identifier: BSD-3-Clause

menu "Device specific drivers configuration"
    rsource "./Kconfig_clock"
    rsource "./Kconfig_dsp"
    rsource "./Kconfig_edma_soc"
    rsource "./Kconfig_ezhv"
    rsource "./Kconfig_inputmux_connections"
    rsource "./Kconfig_iopctl_soc"
    rsource "./Kconfig_mipi_dsi_soc"
    rsource "./Kconfig_power"
    rsource "./Kconfig_pvts"
    rsource "./Kconfig_reset"
    rsource "./Kconfig_romapi"
endmenu
```

## RT700/MIMXRT798S/ezhv/Kconfig.chip
```kconfig
# Copyright 2024-2026 NXP
#
# SPDX-License-Identifier: BSD-3-Clause

# core related
config MCUX_HW_CORE
    string
    default "ezhv"

config MCUX_HW_CORE_EZHV
    bool
    default y

config MCUX_HW_CORE_ID
    string
    default "ezhv"

config MCUX_HW_CORE_ID_EZHV
    bool
    default y

config MCUX_HW_DEVICE_CORE
    string
    default "MIMXRT798S_ezhv"

config MCUX_HW_SOC_SERIES_RT
    bool
    default y
```
