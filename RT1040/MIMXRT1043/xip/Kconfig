## RT1050/MIMXRT1052/drivers/Kconfig
```kconfig
menu "Device specific drivers"
    config MCUX_COMPONENT_driver.clock
        bool "Use driver clock"
        # select MCUX_COMPONENT_driver.common

        if MCUX_COMPONENT_driver.clock

        endif

    config MCUX_COMPONENT_driver.iomuxc
        bool "Use driver iomuxc"
        select MCUX_COMPONENT_driver.common

        if MCUX_COMPONENT_driver.iomuxc

        endif

    rsource "./flexram/Kconfig"
    rsource "./romapi/Kconfig"
    rsource "./nic301/Kconfig"
endmenu
```

## RT1050/MIMXRT1052/drivers/romapi/Kconfig
```kconfig
    config MCUX_COMPONENT_driver.romapi
        bool "Use driver ROM API"
        select MCUX_COMPONENT_driver.common

        if MCUX_COMPONENT_driver.romapi

        endif
```

## RT1150/MIMXRT1151/xip/Kconfig
```kconfig
# Copyright 2024 NXP
#
# SPDX-License-Identifier: BSD-3-Clause

rsource "../../../RT1150/MIMXRT1152/xip/Kconfig"
```

## RT1150/MIMXRT1152/drivers/flexram/Kconfig
```kconfig
# Copyright 2024 NXP
#
# SPDX-License-Identifier: BSD-3-Clause


    config MCUX_COMPONENT_driver.flexram_allocate
        bool "flexram_allocate"
        select MCUX_COMPONENT_driver.common

        if MCUX_COMPONENT_driver.flexram_allocate

        endif
```

## RT1150/MIMXRT1152/drivers/power/Kconfig
```kconfig
# Copyright 2024 NXP
#
# SPDX-License-Identifier: BSD-3-Clause

    config MCUX_COMPONENT_driver.dcdc_2
        bool "dcdc"
        select MCUX_COMPONENT_driver.common

        if MCUX_COMPONENT_driver.dcdc_2

        endif

    config MCUX_COMPONENT_driver.gpc_xxx_ctrl
        bool "gpc"
        select MCUX_COMPONENT_driver.common

        if MCUX_COMPONENT_driver.gpc_xxx_ctrl

        endif

    config MCUX_COMPONENT_driver.pgmc
        bool "pgmc"
        select MCUX_COMPONENT_driver.common

        if MCUX_COMPONENT_driver.pgmc

        endif

    config MCUX_COMPONENT_driver.anadig_pmu
        bool "pmu"
        # select MCUX_COMPONENT_driver.common

        if MCUX_COMPONENT_driver.anadig_pmu

        endif

    config MCUX_COMPONENT_driver.src_2
        bool "src"
        select MCUX_COMPONENT_driver.common

        if MCUX_COMPONENT_driver.src_2

        endif
```

## RT1160/MIMXRT1165/cm4/Kconfig
```kconfig
config MCUX_HW_DEVICE_MIMXRT1165_CORE_ID_CM4
    bool
    default y

    imply MCUX_COMPONENT_driver.cache_lmem if MCUX_PRJSEG_module.device.suite

rsource "Kconfig.chip"
rsource "Kconfig.defconfig"
```

## RT1160/MIMXRT1166/cm7/Kconfig
```kconfig
config MCUX_HW_DEVICE_MIMXRT1166_CORE_ID_CM7
    bool
    default y

    imply MCUX_COMPONENT_driver.cache_armv7_m7 if MCUX_PRJSEG_module.device.suite

rsource "Kconfig.chip"
rsource "Kconfig.defconfig"
rsource "../xip/Kconfig"
```

## RT1170/MIMXRT1176/drivers/anatop_ai/Kconfig
```kconfig
    config MCUX_COMPONENT_driver.anatop_ai
        bool "Use driver anatop_ai"
        select MCUX_COMPONENT_driver.common

        if MCUX_COMPONENT_driver.anatop_ai

        endif
```

## RT1170/MIMXRT1176/drivers/flexram/Kconfig
```kconfig
    config MCUX_COMPONENT_driver.flexram_allocate
        bool "Use driver flexram_allocate"
        select MCUX_COMPONENT_driver.common

        if MCUX_COMPONENT_driver.flexram_allocate

        endif
```

## RT1170/MIMXRT1176/drivers/memory/Kconfig
```kconfig
    config MCUX_COMPONENT_driver.memory
        bool "Use driver memory"
        select MCUX_COMPONENT_driver.common

        if MCUX_COMPONENT_driver.memory

        endif
```

## RT1170/MIMXRT1176/drivers/nic301/Kconfig
```kconfig
    config MCUX_COMPONENT_driver.nic301
        bool "Use driver nic301"
        select MCUX_COMPONENT_driver.common

        if MCUX_COMPONENT_driver.nic301

        endif
```

## RT1170/MIMXRT1176/xip/Kconfig
```kconfig
menu "Device Boot Header"
    config MCUX_COMPONENT_device.boot_header
        bool "Use device boot header"
endmenu
```

## RT1180/MIMXRT1181/drivers/Kconfig
```kconfig
menu "Device specific drivers"
    rsource "../../../RT1180/MIMXRT1189/drivers/Kconfig_common"
endmenu
```

## RT1180/MIMXRT1182/drivers/Kconfig
```kconfig
menu "Device specific drivers"
    rsource "../../../RT1180/MIMXRT1189/drivers/Kconfig_common"
    rsource "../../../RT1180/MIMXRT1189/drivers/ecat/Kconfig"
endmenu
```

## RT1180/MIMXRT1185/cm7/Kconfig.chip
```kconfig
# Copyright 2024 NXP
#
# SPDX-License-Identifier: BSD-3-Clause

# core related
config MCUX_HW_CORE
    string
    default "cm7f"

config MCUX_HW_CORE_CM7F
    bool
    default y

config MCUX_HW_CORE_ID
    string
    default "cm7"

config MCUX_HW_CORE_ID_CM7
    bool
    default y

config MCUX_HW_DEVICE_CORE
    string
    default "MIMXRT1185_cm7"

config MCUX_HW_FPU
    string
    default "DP_FPU"

config MCUX_HW_FPU_TYPE
    string
    default "fpv5_dp"

config MCUX_HW_FPV5_DP
    bool
    default y

config MCUX_HW_INT_PRIO_BITS
    int
    default 4

config MCUX_TOOLCHAIN_MCUX_STARTUP
    string
    default "mimxrt1185_cm7"

config MCUX_TOOLCHAIN_LINKER_DEVICE_PREFIX
    string
    default "MIMXRT1185xxxxx_cm7"

config MCUX_TOOLCHAIN_IAR_CPU_IDENTIFIER
    string
    default "MIMXRT1185xxx8_M7"

config MCUX_TOOLCHAIN_MDK_CPU_IDENTIFIER
    string
    default "MIMXRT1185CVJ8C:cm7" if MCUX_HW_DEVICE_PART_MIMXRT1185CVJ8C
    default "MIMXRT1185XVJ8C:cm7" if MCUX_HW_DEVICE_PART_MIMXRT1185XVJ8C

config MCUX_TOOLCHAIN_JLINK_CPU_IDENTIFIER
    string
    default "MIMXRT1185xxx8_M7"
```

## RT1180/MIMXRT1187/drivers/Kconfig
```kconfig
# Copyright 2024 NXP
#
# SPDX-License-Identifier: BSD-3-Clause

menu "Device specific drivers"
    rsource "../../../RT1180/MIMXRT1189/drivers/Kconfig_common"
endmenu
```

## RT1180/MIMXRT1189/drivers/Kconfig
```kconfig
# Copyright 2024 NXP
#
# SPDX-License-Identifier: BSD-3-Clause

menu "Device specific drivers"
    rsource "./Kconfig_common"
    rsource "./ecat/Kconfig"
endmenu
```

## RT1180/MIMXRT1189/drivers/ecat/Kconfig
```kconfig
    config MCUX_COMPONENT_driver.ecat
        bool "Use driver ecat"
        select MCUX_COMPONENT_driver.common

        if MCUX_COMPONENT_driver.ecat

        endif
```

## RT1180/MIMXRT118C/Kconfig
```kconfig
# Copyright 2024 NXP
# All rights reserved.
#
# SPDX-License-Identifier: BSD-3-Clause

rsource "${core_id}/Kconfig"
rsource "Kconfig.chip"
rsource "drivers/Kconfig"
rsource "../../../../devices/arm/Kconfig.common"
rsource "Kconfig.defconfig"

config MCUX_HW_DEVICE_MIMXRT118C
    # bool "Device MIMXRT118C Configuration"
    bool
    default y
```

## RT600/MIMXRT633S/drivers/Kconfig
```kconfig
# Copyright 2024 NXP
# All rights reserved.
#
# SPDX-License-Identifier: BSD-3-Clause

menu "Device specific drivers configuration"

    config MCUX_COMPONENT_driver.clock
         bool "clock"
         default y

    config MCUX_COMPONENT_driver.i2s_bridge
         bool "i2s_bridge"
         default y

    config MCUX_COMPONENT_driver.inputmux_connections
         bool "inputmux_connections"
         default y

    config MCUX_COMPONENT_driver.power
         bool "power"
         default y

    config MCUX_COMPONENT_driver.reset
         bool "reset"
         default y

endmenu
```
