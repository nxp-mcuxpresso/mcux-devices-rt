## RTL345/IMXRTL3459AAA/Kconfig
```kconfig
# Copyright 2025-2026 NXP
#
# SPDX-License-Identifier: BSD-3-Clause

rsource "${core_id}/Kconfig"

rsource "Kconfig.chip"
rsource "drivers/Kconfig"
rsource "Kconfig.defconfig"
```

## RTL345/IMXRTL3459AAA/Kconfig.chip
```kconfig
# Copyright 2024-2025 NXP
# All rights reserved.
#
# SPDX-License-Identifier: BSD-3-Clause

# product related

config MCUX_HW_SOC_SERIES_RT
    bool
    default y

config MCUX_HW_SOC_MULTICORE_DEVICE
    bool
    default y

# device related

config MCUX_HW_DEVICE_ID_IMXRTL3459AAAxxxxx
    bool

choice MCUX_HW_DEVICE_PART_IMXRTL3459AAA
    prompt "Device IMXRTL3459AAA Part"
    config MCUX_HW_DEVICE_PART_IMXRTL3459AAAFAWAR
    bool "IMXRTL3459AAAFAWAR"
    select MCUX_HW_DEVICE_ID_IMXRTL3459AAAxxxxx
    config MCUX_HW_DEVICE_PART_IMXRTL3459AAAFBWAR
    bool "IMXRTL3459AAAFBWAR"
    select MCUX_HW_DEVICE_ID_IMXRTL3459AAAxxxxx
endchoice

config MCUX_HW_DEVICE_ID
    string
    default "IMXRTL3459AAAxxxxx" if MCUX_HW_DEVICE_ID_IMXRTL3459AAAxxxxx

config MCUX_HW_DEVICE_PART
    string
    default "IMXRTL3459AAAFAWAR" if MCUX_HW_DEVICE_PART_IMXRTL3459AAAFAWAR
    default "IMXRTL3459AAAFBWAR" if MCUX_HW_DEVICE_PART_IMXRTL3459AAAFBWAR

# ip information

config MCUX_HW_IP_DriverType_DMA_CRC
    bool
    default y
    depends on MCUX_HW_DEVICE_ID_IMXRTL3459AAAxxxxx

config MCUX_HW_IP_DriverType_XSPI
    bool
    default y
    depends on MCUX_HW_DEVICE_ID_IMXRTL3459AAAxxxxx
```

## RTL345/IMXRTL3459AAA/cm55_core0/Kconfig
```kconfig
# Copyright 2026 NXP
#
# SPDX-License-Identifier: BSD-3-Clause

config MCUX_HW_DEVICE_IMXRTL3459AAA_CORE_ID_cm55_core0
    bool
    default y

rsource "Kconfig.chip"
rsource "../../../../../devices/arm/Kconfig.common"

## Project segment and component dependency data
config MCUX_HW_DEVICE_IMXRTL3459AAA
    # bool "Device IMXRTL3459AAA Configuration"
    bool
    default y

    # component dependency
    select MCUX_COMPONENT_component.usart_adapter if MCUX_COMPONENT_component.serial_manager_uart
    select MCUX_COMPONENT_component.usart_adapter if MCUX_COMPONENT_utility.debug_console_lite
```

## RTL345/IMXRTL3459AAA/cm55_core0/Kconfig.chip
```kconfig
# Copyright 2024-2025 NXP
# All rights reserved.
#
# SPDX-License-Identifier: BSD-3-Clause

# core related

config MCUX_HW_CORE
    string
    default "cm55"

config MCUX_HW_CORE_CM55
    bool
    default y

config MCUX_HW_CORE_ID
    string
    default "cm55_core0"

config MCUX_HW_CORE_ID_CM55_CORE0
    bool
    default y

config MCUX_HW_DSP
    bool
    default y

config MCUX_HW_MPU
    bool
    default y

config MCUX_HW_FPU
    string
    default "SP_FPU"

config MCUX_HW_FPU_TYPE
    string
    default "fpv5_dp"

config MCUX_HW_FPV5_DP
    bool
    default y

config MCUX_HW_SAU
    bool
    default y

config MCUX_HW_INT_PRIO_BITS
    int
    default 3

# device related

config MCUX_HW_DEVICE_CORE
    string
    default "IMXRTL3459AAA_cm55_core0"

# For chipmodel generated files

config MCUX_TOOLCHAIN_LINKER_DEVICE_PREFIX
    string
    default "IMXRTL3459AAAxxxxx_cm55_core0" if MCUX_HW_DEVICE_ID_IMXRTL3459AAAxxxxx

config MCUX_TOOLCHAIN_MCUX_STARTUP
    string
    default "imxrtl3459aaa_cm55_core0"

# Toolchain related

config MCUX_TOOLCHAIN_IAR_CPU_IDENTIFIER
    string
    default "IMXRTL3459AAA_M55_0" if MCUX_HW_DEVICE_ID_IMXRTL3459AAAxxxxx

config MCUX_TOOLCHAIN_MDK_CPU_IDENTIFIER
    string
    default "IMXRTL3459AAAFAWAR:cm55_core0" if MCUX_HW_DEVICE_PART_IMXRTL3459AAAFAWAR
    default "IMXRTL3459AAAFBWAR:cm55_core0" if MCUX_HW_DEVICE_PART_IMXRTL3459AAAFBWAR

config MCUX_TOOLCHAIN_JLINK_CPU_IDENTIFIER
    string
    default "IMXRTL3459AAA_M55_0" if MCUX_HW_DEVICE_ID_IMXRTL3459AAAxxxxx

# core-specific ip information

config MCUX_HW_IP_DriverType_ADSS_PMON
    bool
    default y
    depends on MCUX_HW_DEVICE_ID_IMXRTL3459AAAxxxxx

config MCUX_HW_IP_DriverType_CDOG
    bool
    default y
    depends on MCUX_HW_DEVICE_ID_IMXRTL3459AAAxxxxx

config MCUX_HW_IP_DriverType_CTIMER
    bool
    default y
    depends on MCUX_HW_DEVICE_ID_IMXRTL3459AAAxxxxx

config MCUX_HW_IP_DriverType_DBGMB
    bool
    default y
    depends on MCUX_HW_DEVICE_ID_IMXRTL3459AAAxxxxx

config MCUX_HW_IP_DriverType_FLEXCOMM
    bool
    default y
    depends on MCUX_HW_DEVICE_ID_IMXRTL3459AAAxxxxx

config MCUX_HW_IP_DriverType_FLEXCOMM_I2C
    bool
    default y
    depends on MCUX_HW_DEVICE_ID_IMXRTL3459AAAxxxxx

config MCUX_HW_IP_DriverType_FLEXCOMM_SPI
    bool
    default y
    depends on MCUX_HW_DEVICE_ID_IMXRTL3459AAAxxxxx

config MCUX_HW_IP_DriverType_FLEXCOMM_USART
    bool
    default y
    depends on MCUX_HW_DEVICE_ID_IMXRTL3459AAAxxxxx

config MCUX_HW_IP_DriverType_GINT
    bool
    default y
    depends on MCUX_HW_DEVICE_ID_IMXRTL3459AAAxxxxx

config MCUX_HW_IP_DriverType_GPIO_PORT
    bool
    default y
    depends on MCUX_HW_DEVICE_ID_IMXRTL3459AAAxxxxx

config MCUX_HW_IP_DriverType_HSI
    bool
    default y
    depends on MCUX_HW_DEVICE_ID_IMXRTL3459AAAxxxxx

config MCUX_HW_IP_DriverType_HSI_PORT
    bool
    default y
    depends on MCUX_HW_DEVICE_ID_IMXRTL3459AAAxxxxx

config MCUX_HW_IP_DriverType_I3C
    bool
    default y
    depends on MCUX_HW_DEVICE_ID_IMXRTL3459AAAxxxxx

config MCUX_HW_IP_DriverType_INPUTMUX
    bool
    default y
    depends on MCUX_HW_DEVICE_ID_IMXRTL3459AAAxxxxx

config MCUX_HW_IP_DriverType_MCO_CRC
    bool
    default y
    depends on MCUX_HW_DEVICE_ID_IMXRTL3459AAAxxxxx

config MCUX_HW_IP_DriverType_MRT
    bool
    default y
    depends on MCUX_HW_DEVICE_ID_IMXRTL3459AAAxxxxx

config MCUX_HW_IP_DriverType_OSTIMER
    bool
    default y
    depends on MCUX_HW_DEVICE_ID_IMXRTL3459AAAxxxxx

config MCUX_HW_IP_DriverType_PINT
    bool
    default y
    depends on MCUX_HW_DEVICE_ID_IMXRTL3459AAAxxxxx

config MCUX_HW_IP_DriverType_QSPI_FLR
    bool
    default y
    depends on MCUX_HW_DEVICE_ID_IMXRTL3459AAAxxxxx

config MCUX_HW_IP_DriverType_SCTIMER
    bool
    default y
    depends on MCUX_HW_DEVICE_ID_IMXRTL3459AAAxxxxx

config MCUX_HW_IP_DriverType_SDMA
    bool
    default y
    depends on MCUX_HW_DEVICE_ID_IMXRTL3459AAAxxxxx

config MCUX_HW_IP_DriverType_TRNG
    bool
    default y
    depends on MCUX_HW_DEVICE_ID_IMXRTL3459AAAxxxxx

config MCUX_HW_IP_DriverType_UTICK
    bool
    default y
    depends on MCUX_HW_DEVICE_ID_IMXRTL3459AAAxxxxx

config MCUX_HW_IP_DriverType_WWDT
    bool
    default y
    depends on MCUX_HW_DEVICE_ID_IMXRTL3459AAAxxxxx
```

## RTL345/IMXRTL3459AAA/cm55_core1/Kconfig
```kconfig
# Copyright 2026 NXP
#
# SPDX-License-Identifier: BSD-3-Clause

config MCUX_HW_DEVICE_IMXRTL3459AAA_CORE_ID_cm55_core1
    bool
    default y

rsource "Kconfig.chip"
rsource "../../../../../devices/arm/Kconfig.common"

## Project segment and component dependency data
config MCUX_HW_DEVICE_IMXRTL3459AAA
    # bool "Device IMXRTL3459AAA Configuration"
    bool
    default y
```

## RTL345/IMXRTL3459AAA/cm55_core1/Kconfig.chip
```kconfig
# Copyright 2024-2025 NXP
# All rights reserved.
#
# SPDX-License-Identifier: BSD-3-Clause

# core related

config MCUX_HW_CORE
    string
    default "cm55"

config MCUX_HW_CORE_CM55
    bool
    default y

config MCUX_HW_CORE_ID
    string
    default "cm55_core1"

config MCUX_HW_CORE_ID_CM55_CORE1
    bool
    default y

config MCUX_HW_DSP
    bool
    default y

config MCUX_HW_MPU
    bool
    default y

config MCUX_HW_FPU
    string
    default "SP_FPU"

config MCUX_HW_FPU_TYPE
    string
    default "fpv5_dp"

config MCUX_HW_FPV5_DP
    bool
    default y

config MCUX_HW_SAU
    bool
    default n

config MCUX_HW_INT_PRIO_BITS
    int
    default 3

# device related

config MCUX_HW_DEVICE_CORE
    string
    default "IMXRTL3459AAA_cm55_core1"

# For chipmodel generated files

config MCUX_TOOLCHAIN_LINKER_DEVICE_PREFIX
    string
    default "IMXRTL3459AAAxxxxx_cm55_core1" if MCUX_HW_DEVICE_ID_IMXRTL3459AAAxxxxx

config MCUX_TOOLCHAIN_MCUX_STARTUP
    string
    default "imxrtl3459aaa_cm55_core1"

# Toolchain related

config MCUX_TOOLCHAIN_IAR_CPU_IDENTIFIER
    string
    default "IMXRTL3459AAA_M55_1" if MCUX_HW_DEVICE_ID_IMXRTL3459AAAxxxxx

config MCUX_TOOLCHAIN_MDK_CPU_IDENTIFIER
    string
    default "IMXRTL3459AAAFAWAR:cm55_core1" if MCUX_HW_DEVICE_PART_IMXRTL3459AAAFAWAR
    default "IMXRTL3459AAAFBWAR:cm55_core1" if MCUX_HW_DEVICE_PART_IMXRTL3459AAAFBWAR

config MCUX_TOOLCHAIN_JLINK_CPU_IDENTIFIER
    string
    default "IMXRTL3459AAA_M55_1" if MCUX_HW_DEVICE_ID_IMXRTL3459AAAxxxxx

# core-specific ip information

config MCUX_HW_IP_DriverType_EDMA5
    bool
    default y
    depends on MCUX_HW_DEVICE_ID_IMXRTL3459AAAxxxxx
```

## RTL345/IMXRTL3459AAA/drivers/Kconfig
```kconfig
# Copyright 2025 NXP
#
# SPDX-License-Identifier: BSD-3-Clause

menu "Device specific drivers configuration"

    rsource "romapi/Kconfig"

    config MCUX_COMPONENT_driver.clock
         select MCUX_COMPONENT_driver.rpu
         bool "clock"
         default y
         depends on MCUX_HW_CORE_ID_CM55_CORE0

    config MCUX_COMPONENT_driver.reset
         select MCUX_COMPONENT_driver.rpu if MCUX_HW_CORE_ID_CM55_CORE0
         bool "reset"
         default y

    config MCUX_COMPONENT_driver.power
         bool "power"
         default y
         depends on MCUX_HW_CORE_ID_CM55_CORE0

    config MCUX_COMPONENT_driver.rpu
         bool "rpu"
         default y
         depends on MCUX_HW_CORE_ID_CM55_CORE0

    config MCUX_COMPONENT_driver.rtl3450_swm
         select MCUX_COMPONENT_driver.rpu
         bool "rtl3450_swm"
         default y
         depends on MCUX_HW_CORE_ID_CM55_CORE0

    config MCUX_COMPONENT_driver.flexcomm_qspi_flr
         select MCUX_COMPONENT_driver.flexcomm
         bool "qspi_flr"
         default n

    config MCUX_COMPONENT_driver.flexcomm_qspi_flr_dma
         bool "flexcomm_qspi_flr_dma"
         select MCUX_COMPONENT_driver.flexcomm_qspi_flr
         select MCUX_COMPONENT_driver.lpc_dma
         default n

     config MCUX_COMPONENT_driver.event_ctrl
         bool "event_ctrl"
         default y
         depends on MCUX_HW_CORE_ID_CM55_CORE0

    config MCUX_COMPONENT_driver.dma_mux
         bool "dma_mux"
         default y

    config MCUX_COMPONENT_driver.fault_handler
         bool "fault_handler"
         default y
endmenu
```

## RTL345/IMXRTL3459AAA/drivers/romapi/Kconfig
```kconfig
# Copyright 2025-2026 NXP
#
# SPDX-License-Identifier: BSD-3-Clause

config MCUX_HAS_COMPONENT_driver.romapi
    bool
    default y

config MCUX_COMPONENT_driver.romapi
    bool "romapi"
    select MCUX_COMPONENT_driver.common
    select MCUX_COMPONENT_driver.romapi_nboot
    select MCUX_COMPONENT_driver.romapi_runbootloader
    select MCUX_COMPONENT_driver.romapi_kbapi
    select MCUX_COMPONENT_driver.romapi_flash
    select MCUX_COMPONENT_driver.romapi_otp
    depends on MCUX_HAS_COMPONENT_driver.romapi

config MCUX_COMPONENT_driver.romapi_nboot
    bool "romapi_nboot"
    select MCUX_COMPONENT_driver.common
    depends on MCUX_HAS_COMPONENT_driver.romapi

config MCUX_COMPONENT_driver.romapi_runbootloader
    bool "romapi_runbootloader"
    select MCUX_COMPONENT_driver.common
    depends on MCUX_HAS_COMPONENT_driver.romapi

config MCUX_COMPONENT_driver.romapi_kbapi
    bool "romapi_kbapi"
    select MCUX_COMPONENT_driver.common
    depends on MCUX_HAS_COMPONENT_driver.romapi

config MCUX_COMPONENT_driver.romapi_flash
    bool "romapi_flash"
    select MCUX_COMPONENT_driver.common
    depends on MCUX_HAS_COMPONENT_driver.romapi

config MCUX_COMPONENT_driver.romapi_otp
    bool "romapi_otp"
    select MCUX_COMPONENT_driver.common
    depends on MCUX_HAS_COMPONENT_driver.romapi
```
