## RT1180/MIMXRT118D/Kconfig
```kconfig
# Copyright 2024 NXP
# All rights reserved.
#
# SPDX-License-Identifier: BSD-3-Clause

rsource "${core_id}/Kconfig"
rsource "Kconfig.chip"
rsource "drivers/Kconfig"
rsource "../../../../devices/arm/Kconfig.common"
rsource "Kconfig.defconfig"

config MCUX_HW_DEVICE_MIMXRT118D
    # bool "Device MIMXRT118D Configuration"
    bool
    default y
```

## RT1180/MIMXRT118D/cm33/Kconfig.chip
```kconfig
# Copyright 2024 NXP
#
# SPDX-License-Identifier: BSD-3-Clause

# core related
config MCUX_HW_CORE
    string
    default "cm33"

config MCUX_HW_CORE_CM33
    bool
    default y

config MCUX_HW_CORE_ID
    string
    default "cm33"

config MCUX_HW_CORE_ID_CM33
    bool
    default y

config MCUX_HW_DEVICE_CORE
    string
    default "MIMXRT118D_cm33"

config MCUX_HW_FPU
    string
    default "SP_FPU"

config MCUX_HW_FPU_TYPE
    string
    default "fpv5_sp"

config MCUX_HW_FPV5_SP
    bool
    default y

config MCUX_HW_INT_PRIO_BITS
    int
    default 3

config MCUX_HW_DSP
    bool
    default y
 
config MCUX_HW_SAU
    bool
    default y

config MCUX_TOOLCHAIN_MCUX_STARTUP
    string
    default "mimxrt118D_cm33"

config MCUX_TOOLCHAIN_LINKER_DEVICE_PREFIX
    string
    default "MIMXRT118Dxxxxx_cm33"

config MCUX_TOOLCHAIN_IAR_CPU_IDENTIFIER
    string
    default "MIMXRT118Dxxx8_M33"

config MCUX_TOOLCHAIN_MDK_CPU_IDENTIFIER
    string
    default "MIMXRT118DCHM8C:cm33" if MCUX_HW_DEVICE_PART_MIMXRT118DCHM8C
    default "MIMXRT118DXHM8C:cm33" if MCUX_HW_DEVICE_PART_MIMXRT118DXHM8C

config MCUX_TOOLCHAIN_JLINK_CPU_IDENTIFIER
    string
    default "MIMXRT118Dxxx8_M33"

config MCUX_HW_IP_DriverType_M33_CACHE_MCM
    bool
    default y
    depends on MCUX_HW_DEVICE_ID_MIMXRT118Dxxxxx

config MCUX_HW_IP_DriverType_XCACHE
    bool
    default y
    depends on MCUX_HW_DEVICE_ID_MIMXRT118Dxxxxx
```

## RT1180/MIMXRT118E/Kconfig
```kconfig
# Copyright 2024 NXP
# All rights reserved.
#
# SPDX-License-Identifier: BSD-3-Clause

rsource "${core_id}/Kconfig"
rsource "Kconfig.chip"
rsource "drivers/Kconfig"
rsource "../../../../devices/arm/Kconfig.common"
rsource "Kconfig.defconfig"

config MCUX_HW_DEVICE_MIMXRT118E
    # bool "Device MIMXRT118E Configuration"
    bool
    default y
```

## RT2660/MIMXRT2661/Kconfig
```kconfig
# Copyright 2025 NXP
# All rights reserved.
#
# SPDX-License-Identifier: BSD-3-Clause

rsource "Kconfig.chip"
rsource "drivers/Kconfig"
rsource "../../../../devices/arm/Kconfig.common"
rsource "Kconfig.defconfig"
# rsource "xip/Kconfig"

config MCUX_HW_DEVICE_MIMXRT2661
    # bool "Device MIMXRT2661 Configuration"
    bool
    default y

    imply MCUX_COMPONENT_driver.cache_llc if MCUX_PRJSEG_module.device.suite
    imply MCUX_COMPONENT_driver.cache_armv7_m7 if MCUX_PRJSEG_module.device.suite

    # eDMA component dependency
    select MCUX_COMPONENT_driver.edma_soc if MCUX_COMPONENT_driver.edma_unified
    select MCUX_COMPONENT_driver.edma_unified if MCUX_COMPONENT_driver.sai_edma
    select MCUX_COMPONENT_driver.edma_unified if MCUX_COMPONENT_driver.lpuart_edma
    select MCUX_COMPONENT_driver.edma_unified if MCUX_COMPONENT_driver.lpspi_edma
    select MCUX_COMPONENT_driver.edma_unified if MCUX_COMPONENT_driver.lpi2c_edma
    select MCUX_COMPONENT_driver.edma_unified if MCUX_COMPONENT_driver.i3c_edma
    select MCUX_COMPONENT_driver.edma_unified if MCUX_COMPONENT_driver.xspi_edma
    select MCUX_COMPONENT_driver.edma_unified if MCUX_COMPONENT_driver.flexio_uart_edma
    select MCUX_COMPONENT_driver.edma_unified if MCUX_COMPONENT_driver.flexio_spi_edma
    select MCUX_COMPONENT_driver.edma_unified if MCUX_COMPONENT_driver.flexio_i2s_edma
    select MCUX_COMPONENT_driver.edma_unified if MCUX_COMPONENT_driver.flexcan_edma
    select MCUX_COMPONENT_driver.edma_unified if MCUX_COMPONENT_driver.asrc_edma
```

## RT2660/MIMXRT2661/Kconfig.chip
```kconfig
# Copyright 2024-2025 NXP
# All rights reserved.
#
# SPDX-License-Identifier: BSD-3-Clause

# product related

config MCUX_HW_SOC_SERIES_RT
    bool
    default y

config MCUX_HW_SOC_SINGLECORE_DEVICE
    bool
    default y

# core related

config MCUX_HW_CORE
    string
    default "cm85"

config MCUX_HW_CORE_CM85
    bool
    default y

config MCUX_HW_CORE_ID
    string
    default "cm85"

config MCUX_HW_CORE_ID_CM85
    bool
    default y

config MCUX_HW_DSP
    bool
    default y

config MCUX_HW_MPU
    bool
    default y

config MCUX_HW_FPU
    string
    default "DP_FPU"

config MCUX_HW_FPU_TYPE
    string
    default "fpv5_dp"

config MCUX_HW_FPV5_DP
    bool
    default y

config MCUX_HW_SAU
    bool
    default y

config MCUX_HW_INT_PRIO_BITS
    int
    default 3

# device related

config MCUX_HW_DEVICE_CORE
    string
    default "MIMXRT2661"

config MCUX_HW_DEVICE_ID_MIMXRT2661xxxxx
    bool

choice MCUX_HW_DEVICE_PART_MIMXRT2661
    prompt "Device MIMXRT2661 Part"
    config MCUX_HW_DEVICE_PART_MIMXRT2661DHPAA
    bool "MIMXRT2661DHPAA"
    select MCUX_HW_DEVICE_ID_MIMXRT2661xxxxx
    config MCUX_HW_DEVICE_PART_MIMXRT2661DVVAA
    bool "MIMXRT2661DVVAA"
    select MCUX_HW_DEVICE_ID_MIMXRT2661xxxxx
    config MCUX_HW_DEVICE_PART_MIMXRT2661CHPAA
    bool "MIMXRT2661CHPAA"
    select MCUX_HW_DEVICE_ID_MIMXRT2661xxxxx
    config MCUX_HW_DEVICE_PART_MIMXRT2661CVVAA
    bool "MIMXRT2661CVVAA"
    select MCUX_HW_DEVICE_ID_MIMXRT2661xxxxx
    config MCUX_HW_DEVICE_PART_MIMXRT2661XHP8A
    bool "MIMXRT2661XHP8A"
    select MCUX_HW_DEVICE_ID_MIMXRT2661xxxxx
    config MCUX_HW_DEVICE_PART_MIMXRT2661XVV8A
    bool "MIMXRT2661XVV8A"
    select MCUX_HW_DEVICE_ID_MIMXRT2661xxxxx
endchoice

config MCUX_HW_DEVICE_ID
    string
    default "MIMXRT2661xxxxx" if MCUX_HW_DEVICE_ID_MIMXRT2661xxxxx

config MCUX_HW_DEVICE_PART
    string
    default "MIMXRT2661DHPAA" if MCUX_HW_DEVICE_PART_MIMXRT2661DHPAA
    default "MIMXRT2661DVVAA" if MCUX_HW_DEVICE_PART_MIMXRT2661DVVAA
    default "MIMXRT2661CHPAA" if MCUX_HW_DEVICE_PART_MIMXRT2661CHPAA
    default "MIMXRT2661CVVAA" if MCUX_HW_DEVICE_PART_MIMXRT2661CVVAA
    default "MIMXRT2661XHP8A" if MCUX_HW_DEVICE_PART_MIMXRT2661XHP8A
    default "MIMXRT2661XVV8A" if MCUX_HW_DEVICE_PART_MIMXRT2661XVV8A

# For chipmodel generated files

config MCUX_TOOLCHAIN_LINKER_DEVICE_PREFIX
    string
    default "MIMXRT2661xxxxx" if MCUX_HW_DEVICE_ID_MIMXRT2661xxxxx

config MCUX_TOOLCHAIN_MCUX_STARTUP
    string
    default "mimxrt2661"

# Toolchain related

config MCUX_TOOLCHAIN_IAR_CPU_IDENTIFIER
    string
    default "MIMXRT2661xxxxx_M85" if MCUX_HW_DEVICE_ID_MIMXRT2661xxxxx

config MCUX_TOOLCHAIN_MDK_CPU_IDENTIFIER
    string
    default "MIMXRT2661CHPAA:cm85" if MCUX_HW_DEVICE_PART_MIMXRT2661CHPAA
    default "MIMXRT2661CVVAA:cm85" if MCUX_HW_DEVICE_PART_MIMXRT2661CVVAA
    default "MIMXRT2661DHPAA:cm85" if MCUX_HW_DEVICE_PART_MIMXRT2661DHPAA
    default "MIMXRT2661DVVAA:cm85" if MCUX_HW_DEVICE_PART_MIMXRT2661DVVAA
    default "MIMXRT2661XHP8A:cm85" if MCUX_HW_DEVICE_PART_MIMXRT2661XHP8A
    default "MIMXRT2661XVV8A:cm85" if MCUX_HW_DEVICE_PART_MIMXRT2661XVV8A

config MCUX_TOOLCHAIN_JLINK_CPU_IDENTIFIER
    string
    default "MIMXRT2661_M85" if MCUX_HW_DEVICE_ID_MIMXRT2661xxxxx

# ip information

config MCUX_HW_IP_DriverType_ACMP
    bool
    default y
    depends on MCUX_HW_DEVICE_ID_MIMXRT2661xxxxx

config MCUX_HW_IP_DriverType_ASRC
    bool
    default y
    depends on MCUX_HW_DEVICE_ID_MIMXRT2661xxxxx

config MCUX_HW_IP_DriverType_AXBS
    bool
    default y
    depends on MCUX_HW_DEVICE_ID_MIMXRT2661xxxxx

config MCUX_HW_IP_DriverType_CACHE
    bool
    default y
    depends on MCUX_HW_DEVICE_ID_MIMXRT2661xxxxx

config MCUX_HW_IP_DriverType_CAN_MB
    bool
    default y
    depends on MCUX_HW_DEVICE_ID_MIMXRT2661xxxxx

config MCUX_HW_IP_DriverType_CCM
    bool
    default y
    depends on MCUX_HW_DEVICE_ID_MIMXRT2661xxxxx

config MCUX_HW_IP_DriverType_CGUANA
    bool
    default y
    depends on MCUX_HW_DEVICE_ID_MIMXRT2661xxxxx

config MCUX_HW_IP_DriverType_CRC
    bool
    default y
    depends on MCUX_HW_DEVICE_ID_MIMXRT2661xxxxx

config MCUX_HW_IP_DriverType_DBGMB
    bool
    default y
    depends on MCUX_HW_DEVICE_ID_MIMXRT2661xxxxx

config MCUX_HW_IP_DriverType_DCIF_1
    bool
    default y
    depends on MCUX_HW_DEVICE_ID_MIMXRT2661xxxxx

config MCUX_HW_IP_DriverType_DIGTMP
    bool
    default y
    depends on MCUX_HW_DEVICE_ID_MIMXRT2661xxxxx

config MCUX_HW_IP_DriverType_EDMA3
    bool
    default y
    depends on MCUX_HW_DEVICE_ID_MIMXRT2661xxxxx

config MCUX_HW_IP_DriverType_EDMA5
    bool
    default y
    depends on MCUX_HW_DEVICE_ID_MIMXRT2661xxxxx

config MCUX_HW_IP_DriverType_ENET
    bool
    default y
    depends on MCUX_HW_DEVICE_ID_MIMXRT2661xxxxx

config MCUX_HW_IP_DriverType_ENET_QOS
    bool
    default y
    depends on MCUX_HW_DEVICE_ID_MIMXRT2661xxxxx

config MCUX_HW_IP_DriverType_EQDC
    bool
    default y
    depends on MCUX_HW_DEVICE_ID_MIMXRT2661xxxxx

config MCUX_HW_IP_DriverType_EVTG
    bool
    default y
    depends on MCUX_HW_DEVICE_ID_MIMXRT2661xxxxx

config MCUX_HW_IP_DriverType_EWM
    bool
    default y
    depends on MCUX_HW_DEVICE_ID_MIMXRT2661xxxxx

config MCUX_HW_IP_DriverType_FLEXCAN
    bool
    default y
    depends on MCUX_HW_DEVICE_ID_MIMXRT2661xxxxx

config MCUX_HW_IP_DriverType_FLEXIO
    bool
    default y
    depends on MCUX_HW_DEVICE_ID_MIMXRT2661xxxxx

config MCUX_HW_IP_DriverType_FLEXSPI_SLV
    bool
    default y
    depends on MCUX_HW_DEVICE_ID_MIMXRT2661xxxxx

config MCUX_HW_IP_DriverType_FREQME
    bool
    default y
    depends on MCUX_HW_DEVICE_ID_MIMXRT2661xxxxx

config MCUX_HW_IP_DriverType_FSB
    bool
    default y
    depends on MCUX_HW_DEVICE_ID_MIMXRT2661xxxxx

config MCUX_HW_IP_DriverType_GPIO
    bool
    default y
    depends on MCUX_HW_DEVICE_ID_MIMXRT2661xxxxx

config MCUX_HW_IP_DriverType_I3C
    bool
    default y
    depends on MCUX_HW_DEVICE_ID_MIMXRT2661xxxxx

config MCUX_HW_IP_DriverType_INPUTMUX
    bool
    default y
    depends on MCUX_HW_DEVICE_ID_MIMXRT2661xxxxx

config MCUX_HW_IP_DriverType_IOMUXC
    bool
    default y
    depends on MCUX_HW_DEVICE_ID_MIMXRT2661xxxxx

config MCUX_HW_IP_DriverType_ISI
    bool
    default y
    depends on MCUX_HW_DEVICE_ID_MIMXRT2661xxxxx

config MCUX_HW_IP_DriverType_JPEGDEC
    bool
    default y
    depends on MCUX_HW_DEVICE_ID_MIMXRT2661xxxxx

config MCUX_HW_IP_DriverType_JPGDECWRP
    bool
    default y
    depends on MCUX_HW_DEVICE_ID_MIMXRT2661xxxxx

config MCUX_HW_IP_DriverType_JTAGC
    bool
    default y
    depends on MCUX_HW_DEVICE_ID_MIMXRT2661xxxxx

config MCUX_HW_IP_DriverType_LLC
    bool
    default y
    depends on MCUX_HW_DEVICE_ID_MIMXRT2661xxxxx

config MCUX_HW_IP_DriverType_LPADC
    bool
    default y
    depends on MCUX_HW_DEVICE_ID_MIMXRT2661xxxxx

config MCUX_HW_IP_DriverType_LPDAC
    bool
    default y
    depends on MCUX_HW_DEVICE_ID_MIMXRT2661xxxxx

config MCUX_HW_IP_DriverType_LPI2C
    bool
    default y
    depends on MCUX_HW_DEVICE_ID_MIMXRT2661xxxxx

config MCUX_HW_IP_DriverType_LPIT
    bool
    default y
    depends on MCUX_HW_DEVICE_ID_MIMXRT2661xxxxx

config MCUX_HW_IP_DriverType_LPSPI
    bool
    default y
    depends on MCUX_HW_DEVICE_ID_MIMXRT2661xxxxx

config MCUX_HW_IP_DriverType_LPTMR
    bool
    default y
    depends on MCUX_HW_DEVICE_ID_MIMXRT2661xxxxx

config MCUX_HW_IP_DriverType_LPUART
    bool
    default y
    depends on MCUX_HW_DEVICE_ID_MIMXRT2661xxxxx

config MCUX_HW_IP_DriverType_MCM
    bool
    default y
    depends on MCUX_HW_DEVICE_ID_MIMXRT2661xxxxx

config MCUX_HW_IP_DriverType_MEMCON
    bool
    default y
    depends on MCUX_HW_DEVICE_ID_MIMXRT2661xxxxx

config MCUX_HW_IP_DriverType_MEMORY
    bool
    default y
    depends on MCUX_HW_DEVICE_ID_MIMXRT2661xxxxx

config MCUX_HW_IP_DriverType_MMU
    bool
    default y
    depends on MCUX_HW_DEVICE_ID_MIMXRT2661xxxxx

config MCUX_HW_IP_DriverType_MODCON
    bool
    default y
    depends on MCUX_HW_DEVICE_ID_MIMXRT2661xxxxx

config MCUX_HW_IP_DriverType_MQS
    bool
    default y
    depends on MCUX_HW_DEVICE_ID_MIMXRT2661xxxxx

config MCUX_HW_IP_DriverType_NIC
    bool
    default y
    depends on MCUX_HW_DEVICE_ID_MIMXRT2661xxxxx

config MCUX_HW_IP_DriverType_NPU
    bool
    default y
    depends on MCUX_HW_DEVICE_ID_MIMXRT2661xxxxx

config MCUX_HW_IP_DriverType_PDCON
    bool
    default y
    depends on MCUX_HW_DEVICE_ID_MIMXRT2661xxxxx

config MCUX_HW_IP_DriverType_PDM
    bool
    default y
    depends on MCUX_HW_DEVICE_ID_MIMXRT2661xxxxx

config MCUX_HW_IP_DriverType_POWERCON
    bool
    default y
    depends on MCUX_HW_DEVICE_ID_MIMXRT2661xxxxx

config MCUX_HW_IP_DriverType_PWM
    bool
    default y
    depends on MCUX_HW_DEVICE_ID_MIMXRT2661xxxxx

config MCUX_HW_IP_DriverType_REFORMATTER
    bool
    default y
    depends on MCUX_HW_DEVICE_ID_MIMXRT2661xxxxx

config MCUX_HW_IP_DriverType_RESETCON
    bool
    default y
    depends on MCUX_HW_DEVICE_ID_MIMXRT2661xxxxx

config MCUX_HW_IP_DriverType_ROMC
    bool
    default y
    depends on MCUX_HW_DEVICE_ID_MIMXRT2661xxxxx

config MCUX_HW_IP_DriverType_RT2K_PMU
    bool
    default y
    depends on MCUX_HW_DEVICE_ID_MIMXRT2661xxxxx

config MCUX_HW_IP_DriverType_RTC_V2
    bool
    default y
    depends on MCUX_HW_DEVICE_ID_MIMXRT2661xxxxx

config MCUX_HW_IP_DriverType_S3MU
    bool
    default y
    depends on MCUX_HW_DEVICE_ID_MIMXRT2661xxxxx

config MCUX_HW_IP_DriverType_SAI
    bool
    default y
    depends on MCUX_HW_DEVICE_ID_MIMXRT2661xxxxx

config MCUX_HW_IP_DriverType_SINC
    bool
    default y
    depends on MCUX_HW_DEVICE_ID_MIMXRT2661xxxxx

config MCUX_HW_IP_DriverType_SPDIF_XCVR
    bool
    default y
    depends on MCUX_HW_DEVICE_ID_MIMXRT2661xxxxx

config MCUX_HW_IP_DriverType_SRAM
    bool
    default y
    depends on MCUX_HW_DEVICE_ID_MIMXRT2661xxxxx

config MCUX_HW_IP_DriverType_SRAMCTL
    bool
    default y
    depends on MCUX_HW_DEVICE_ID_MIMXRT2661xxxxx

config MCUX_HW_IP_DriverType_SRAMC_1
    bool
    default y
    depends on MCUX_HW_DEVICE_ID_MIMXRT2661xxxxx

config MCUX_HW_IP_DriverType_STM
    bool
    default y
    depends on MCUX_HW_DEVICE_ID_MIMXRT2661xxxxx

config MCUX_HW_IP_DriverType_SWT
    bool
    default y
    depends on MCUX_HW_DEVICE_ID_MIMXRT2661xxxxx

config MCUX_HW_IP_DriverType_TENBASET_PHY
    bool
    default y
    depends on MCUX_HW_DEVICE_ID_MIMXRT2661xxxxx

config MCUX_HW_IP_DriverType_TINGPU
    bool
    default y
    depends on MCUX_HW_DEVICE_ID_MIMXRT2661xxxxx

config MCUX_HW_IP_DriverType_TMR_1
    bool
    default y
    depends on MCUX_HW_DEVICE_ID_MIMXRT2661xxxxx

config MCUX_HW_IP_DriverType_TPM
    bool
    default y
    depends on MCUX_HW_DEVICE_ID_MIMXRT2661xxxxx

config MCUX_HW_IP_DriverType_TRDC_1
    bool
    default y
    depends on MCUX_HW_DEVICE_ID_MIMXRT2661xxxxx

config MCUX_HW_IP_DriverType_TRGSYNC
    bool
    default y
    depends on MCUX_HW_DEVICE_ID_MIMXRT2661xxxxx

config MCUX_HW_IP_DriverType_USBNC
    bool
    default y
    depends on MCUX_HW_DEVICE_ID_MIMXRT2661xxxxx

config MCUX_HW_IP_DriverType_USB_HOST_DEVICE_EHCI
    bool
    default y
    depends on MCUX_HW_DEVICE_ID_MIMXRT2661xxxxx

config MCUX_HW_IP_DriverType_USB_HOST_DEVICE_KHCI
    bool
    default y
    depends on MCUX_HW_DEVICE_ID_MIMXRT2661xxxxx

config MCUX_HW_IP_DriverType_USB_HSDCD
    bool
    default y
    depends on MCUX_HW_DEVICE_ID_MIMXRT2661xxxxx

config MCUX_HW_IP_DriverType_USB_PHY
    bool
    default y
    depends on MCUX_HW_DEVICE_ID_MIMXRT2661xxxxx

config MCUX_HW_IP_DriverType_USDHC
    bool
    default y
    depends on MCUX_HW_DEVICE_ID_MIMXRT2661xxxxx

config MCUX_HW_IP_DriverType_VBATCON
    bool
    default y
    depends on MCUX_HW_DEVICE_ID_MIMXRT2661xxxxx

config MCUX_HW_IP_DriverType_XBAR_DSC
    bool
    default y
    depends on MCUX_HW_DEVICE_ID_MIMXRT2661xxxxx

config MCUX_HW_IP_DriverType_XSPI
    bool
    default y
    depends on MCUX_HW_DEVICE_ID_MIMXRT2661xxxxx
```
