## RT2660/MIMXRT2662/drivers/Kconfig
```kconfig
# Copyright 2025 NXP
#
# SPDX-License-Identifier: BSD-3-Clause

menu "Device specific drivers"
    rsource "../../../RT2660/MIMXRT2663/drivers/Kconfig_clock"
    rsource "../../../RT2660/MIMXRT2663/drivers/Kconfig_edma_soc"
    rsource "../../../RT2660/MIMXRT2663/drivers/Kconfig_iomuxc"
    rsource "../../../RT2660/MIMXRT2663/drivers/Kconfig_memory"
    rsource "../../../RT2660/MIMXRT2663/drivers/Kconfig_modcon"
    rsource "../../../RT2660/MIMXRT2663/drivers/Kconfig_power"
    rsource "../../../RT2660/MIMXRT2663/drivers/Kconfig_trdc_soc"
    rsource "../../../RT2660/MIMXRT2663/drivers/Kconfig_mipi_dsi_soc"
    rsource "../../../RT2660/MIMXRT2663/drivers/Kconfig_inputmux_connections"
    rsource "../../../RT2660/MIMXRT2663/drivers/Kconfig_vbatcon"
    rsource "../../../RT2660/MIMXRT2663/drivers/Kconfig_memcon"
    rsource "../../../RT2660/MIMXRT2663/drivers/Kconfig_resetcon"
    rsource "../../../RT2660/MIMXRT2663/drivers/Kconfig_mcm"
endmenu
```

## RT2660/MIMXRT2663/Kconfig
```kconfig
# Copyright 2025 NXP
# All rights reserved.
#
# SPDX-License-Identifier: BSD-3-Clause

rsource "Kconfig.chip"
rsource "drivers/Kconfig"
rsource "../../../../devices/arm/Kconfig.common"
rsource "Kconfig.defconfig"
rsource "xip/Kconfig"

config MCUX_HW_DEVICE_MIMXRT2663
    # bool "Device MIMXRT2663 Configuration"
    bool
    default y

    imply MCUX_COMPONENT_driver.cache_llc if MCUX_PRJSEG_module.device.suite
    imply MCUX_COMPONENT_driver.cache_armv7_m7 if MCUX_PRJSEG_module.device.suite
```

## RT2660/MIMXRT2663/Kconfig.chip
```kconfig
# Copyright 2024-2025 NXP
# All rights reserved.
#
# SPDX-License-Identifier: BSD-3-Clause

# product related

config MCUX_HW_SOC_SERIES_RT
    bool
    default y

config MCUX_HW_SOC_SINGLECORE_DEVICE
    bool
    default y

# core related

config MCUX_HW_CORE
    string
    default "cm85"

config MCUX_HW_CORE_CM85
    bool
    default y

config MCUX_HW_CORE_ID
    string
    default "cm85"

config MCUX_HW_CORE_ID_CM85
    bool
    default y

config MCUX_HW_DSP
    bool
    default y

config MCUX_HW_MPU
    bool
    default y

config MCUX_HW_FPU
    string
    default "DP_FPU"

config MCUX_HW_FPU_TYPE
    string
    default "fpv5_dp"

config MCUX_HW_FPV5_DP
    bool
    default y

config MCUX_HW_SAU
    bool
    default y

config MCUX_HW_INT_PRIO_BITS
    int
    default 3

# device related

config MCUX_HW_DEVICE_CORE
    string
    default "MIMXRT2663"

config MCUX_HW_DEVICE_ID_MIMXRT2663xxxxx
    bool

choice MCUX_HW_DEVICE_PART_MIMXRT2663
    prompt "Device MIMXRT2663 Part"
    config MCUX_HW_DEVICE_PART_MIMXRT2663DHPAA
    bool "MIMXRT2663DHPAA"
    select MCUX_HW_DEVICE_ID_MIMXRT2663xxxxx
    config MCUX_HW_DEVICE_PART_MIMXRT2663DVVAA
    bool "MIMXRT2663DVVAA"
    select MCUX_HW_DEVICE_ID_MIMXRT2663xxxxx
    config MCUX_HW_DEVICE_PART_MIMXRT2663CHPAA
    bool "MIMXRT2663CHPAA"
    select MCUX_HW_DEVICE_ID_MIMXRT2663xxxxx
    config MCUX_HW_DEVICE_PART_MIMXRT2663CVVAA
    bool "MIMXRT2663CVVAA"
    select MCUX_HW_DEVICE_ID_MIMXRT2663xxxxx
    config MCUX_HW_DEVICE_PART_MIMXRT2663XHP8A
    bool "MIMXRT2663XHP8A"
    select MCUX_HW_DEVICE_ID_MIMXRT2663xxxxx
    config MCUX_HW_DEVICE_PART_MIMXRT2663XVV8A
    bool "MIMXRT2663XVV8A"
    select MCUX_HW_DEVICE_ID_MIMXRT2663xxxxx
    config MCUX_HW_DEVICE_PART_MIMXRT2663AHP8A
    bool "MIMXRT2663AHP8A"
    select MCUX_HW_DEVICE_ID_MIMXRT2663xxxxx
endchoice

config MCUX_HW_DEVICE_ID
    string
    default "MIMXRT2663xxxxx" if MCUX_HW_DEVICE_ID_MIMXRT2663xxxxx

config MCUX_HW_DEVICE_PART
    string
    default "MIMXRT2663DHPAA" if MCUX_HW_DEVICE_PART_MIMXRT2663DHPAA
    default "MIMXRT2663DVVAA" if MCUX_HW_DEVICE_PART_MIMXRT2663DVVAA
    default "MIMXRT2663CHPAA" if MCUX_HW_DEVICE_PART_MIMXRT2663CHPAA
    default "MIMXRT2663CVVAA" if MCUX_HW_DEVICE_PART_MIMXRT2663CVVAA
    default "MIMXRT2663XHP8A" if MCUX_HW_DEVICE_PART_MIMXRT2663XHP8A
    default "MIMXRT2663XVV8A" if MCUX_HW_DEVICE_PART_MIMXRT2663XVV8A
    default "MIMXRT2663AHP8A" if MCUX_HW_DEVICE_PART_MIMXRT2663AHP8A

# For chipmodel generated files

config MCUX_TOOLCHAIN_LINKER_DEVICE_PREFIX
    string
    default "MIMXRT2663xxxxx" if MCUX_HW_DEVICE_ID_MIMXRT2663xxxxx

config MCUX_TOOLCHAIN_MCUX_STARTUP
    string
    default "mimxrt2663"

# Toolchain related

config MCUX_TOOLCHAIN_IAR_CPU_IDENTIFIER
    string
    default "MIMXRT2663xxxxx_M85" if MCUX_HW_DEVICE_ID_MIMXRT2663xxxxx

config MCUX_TOOLCHAIN_MDK_CPU_IDENTIFIER
    string
    default "MIMXRT2663AHP8A:cm85" if MCUX_HW_DEVICE_PART_MIMXRT2663AHP8A
    default "MIMXRT2663CHPAA:cm85" if MCUX_HW_DEVICE_PART_MIMXRT2663CHPAA
    default "MIMXRT2663CVVAA:cm85" if MCUX_HW_DEVICE_PART_MIMXRT2663CVVAA
    default "MIMXRT2663DHPAA:cm85" if MCUX_HW_DEVICE_PART_MIMXRT2663DHPAA
    default "MIMXRT2663DVVAA:cm85" if MCUX_HW_DEVICE_PART_MIMXRT2663DVVAA
    default "MIMXRT2663XHP8A:cm85" if MCUX_HW_DEVICE_PART_MIMXRT2663XHP8A
    default "MIMXRT2663XVV8A:cm85" if MCUX_HW_DEVICE_PART_MIMXRT2663XVV8A

config MCUX_TOOLCHAIN_JLINK_CPU_IDENTIFIER
    string
    default "MIMXRT2663_M85" if MCUX_HW_DEVICE_ID_MIMXRT2663xxxxx

# ip information

config MCUX_HW_IP_DriverType_ACMP
    bool
    default y
    depends on MCUX_HW_DEVICE_ID_MIMXRT2663xxxxx

config MCUX_HW_IP_DriverType_ASRC
    bool
    default y
    depends on MCUX_HW_DEVICE_ID_MIMXRT2663xxxxx

config MCUX_HW_IP_DriverType_AUDIO_XCVR
    bool
    default y
    depends on MCUX_HW_DEVICE_ID_MIMXRT2663xxxxx

config MCUX_HW_IP_DriverType_AXBS
    bool
    default y
    depends on MCUX_HW_DEVICE_ID_MIMXRT2663xxxxx

config MCUX_HW_IP_DriverType_CACHE
    bool
    default y
    depends on MCUX_HW_DEVICE_ID_MIMXRT2663xxxxx

config MCUX_HW_IP_DriverType_CAN_MB
    bool
    default y
    depends on MCUX_HW_DEVICE_ID_MIMXRT2663xxxxx

config MCUX_HW_IP_DriverType_CCM
    bool
    default y
    depends on MCUX_HW_DEVICE_ID_MIMXRT2663xxxxx

config MCUX_HW_IP_DriverType_CGUANA
    bool
    default y
    depends on MCUX_HW_DEVICE_ID_MIMXRT2663xxxxx

config MCUX_HW_IP_DriverType_CRC
    bool
    default y
    depends on MCUX_HW_DEVICE_ID_MIMXRT2663xxxxx

config MCUX_HW_IP_DriverType_CSI
    bool
    default y
    depends on MCUX_HW_DEVICE_ID_MIMXRT2663xxxxx

config MCUX_HW_IP_DriverType_DBGMB
    bool
    default y
    depends on MCUX_HW_DEVICE_ID_MIMXRT2663xxxxx

config MCUX_HW_IP_DriverType_DCIF_1
    bool
    default y
    depends on MCUX_HW_DEVICE_ID_MIMXRT2663xxxxx

config MCUX_HW_IP_DriverType_DIGTMP
    bool
    default y
    depends on MCUX_HW_DEVICE_ID_MIMXRT2663xxxxx

config MCUX_HW_IP_DriverType_EDMA3
    bool
    default y
    depends on MCUX_HW_DEVICE_ID_MIMXRT2663xxxxx

config MCUX_HW_IP_DriverType_EDMA5
    bool
    default y
    depends on MCUX_HW_DEVICE_ID_MIMXRT2663xxxxx

config MCUX_HW_IP_DriverType_ENET
    bool
    default y
    depends on MCUX_HW_DEVICE_ID_MIMXRT2663xxxxx

config MCUX_HW_IP_DriverType_ENET_QOS
    bool
    default y
    depends on MCUX_HW_DEVICE_ID_MIMXRT2663xxxxx

config MCUX_HW_IP_DriverType_EQDC
    bool
    default y
    depends on MCUX_HW_DEVICE_ID_MIMXRT2663xxxxx

config MCUX_HW_IP_DriverType_EVTG
    bool
    default y
    depends on MCUX_HW_DEVICE_ID_MIMXRT2663xxxxx

config MCUX_HW_IP_DriverType_EWM
    bool
    default y
    depends on MCUX_HW_DEVICE_ID_MIMXRT2663xxxxx

config MCUX_HW_IP_DriverType_FLEXCAN
    bool
    default y
    depends on MCUX_HW_DEVICE_ID_MIMXRT2663xxxxx

config MCUX_HW_IP_DriverType_FLEXIO
    bool
    default y
    depends on MCUX_HW_DEVICE_ID_MIMXRT2663xxxxx

config MCUX_HW_IP_DriverType_FLEXSPI_SLV
    bool
    default y
    depends on MCUX_HW_DEVICE_ID_MIMXRT2663xxxxx

config MCUX_HW_IP_DriverType_FREQME
    bool
    default y
    depends on MCUX_HW_DEVICE_ID_MIMXRT2663xxxxx

config MCUX_HW_IP_DriverType_FSB
    bool
    default y
    depends on MCUX_HW_DEVICE_ID_MIMXRT2663xxxxx

config MCUX_HW_IP_DriverType_GPIO
    bool
    default y
    depends on MCUX_HW_DEVICE_ID_MIMXRT2663xxxxx

config MCUX_HW_IP_DriverType_I3C
    bool
    default y
    depends on MCUX_HW_DEVICE_ID_MIMXRT2663xxxxx

config MCUX_HW_IP_DriverType_INPUTMUX
    bool
    default y
    depends on MCUX_HW_DEVICE_ID_MIMXRT2663xxxxx

config MCUX_HW_IP_DriverType_IOMUXC
    bool
    default y
    depends on MCUX_HW_DEVICE_ID_MIMXRT2663xxxxx

config MCUX_HW_IP_DriverType_ISI
    bool
    default y
    depends on MCUX_HW_DEVICE_ID_MIMXRT2663xxxxx

config MCUX_HW_IP_DriverType_JPEGDEC
    bool
    default y
    depends on MCUX_HW_DEVICE_ID_MIMXRT2663xxxxx

config MCUX_HW_IP_DriverType_JPGDECWRP
    bool
    default y
    depends on MCUX_HW_DEVICE_ID_MIMXRT2663xxxxx

config MCUX_HW_IP_DriverType_JTAGC
    bool
    default y
    depends on MCUX_HW_DEVICE_ID_MIMXRT2663xxxxx

config MCUX_HW_IP_DriverType_LLC
    bool
    default y
    depends on MCUX_HW_DEVICE_ID_MIMXRT2663xxxxx

config MCUX_HW_IP_DriverType_LPADC
    bool
    default y
    depends on MCUX_HW_DEVICE_ID_MIMXRT2663xxxxx

config MCUX_HW_IP_DriverType_LPDAC
    bool
    default y
    depends on MCUX_HW_DEVICE_ID_MIMXRT2663xxxxx

config MCUX_HW_IP_DriverType_LPI2C
    bool
    default y
    depends on MCUX_HW_DEVICE_ID_MIMXRT2663xxxxx

config MCUX_HW_IP_DriverType_LPIT
    bool
    default y
    depends on MCUX_HW_DEVICE_ID_MIMXRT2663xxxxx

config MCUX_HW_IP_DriverType_LPSPI
    bool
    default y
    depends on MCUX_HW_DEVICE_ID_MIMXRT2663xxxxx

config MCUX_HW_IP_DriverType_LPTMR
    bool
    default y
    depends on MCUX_HW_DEVICE_ID_MIMXRT2663xxxxx

config MCUX_HW_IP_DriverType_LPUART
    bool
    default y
    depends on MCUX_HW_DEVICE_ID_MIMXRT2663xxxxx

config MCUX_HW_IP_DriverType_MCM
    bool
    default y
    depends on MCUX_HW_DEVICE_ID_MIMXRT2663xxxxx

config MCUX_HW_IP_DriverType_MEMCON
    bool
    default y
    depends on MCUX_HW_DEVICE_ID_MIMXRT2663xxxxx

config MCUX_HW_IP_DriverType_MEMORY
    bool
    default y
    depends on MCUX_HW_DEVICE_ID_MIMXRT2663xxxxx

config MCUX_HW_IP_DriverType_MIPI_CSI2RX_RAMBUS
    bool
    default y
    depends on MCUX_HW_DEVICE_ID_MIMXRT2663xxxxx

config MCUX_HW_IP_DriverType_MIPI_DSI_SPLIT_1
    bool
    default y
    depends on MCUX_HW_DEVICE_ID_MIMXRT2663xxxxx

config MCUX_HW_IP_DriverType_MMU
    bool
    default y
    depends on MCUX_HW_DEVICE_ID_MIMXRT2663xxxxx

config MCUX_HW_IP_DriverType_MODCON
    bool
    default y
    depends on MCUX_HW_DEVICE_ID_MIMXRT2663xxxxx

config MCUX_HW_IP_DriverType_MQS
    bool
    default y
    depends on MCUX_HW_DEVICE_ID_MIMXRT2663xxxxx

config MCUX_HW_IP_DriverType_NIC
    bool
    default y
    depends on MCUX_HW_DEVICE_ID_MIMXRT2663xxxxx

config MCUX_HW_IP_DriverType_NPU
    bool
    default y
    depends on MCUX_HW_DEVICE_ID_MIMXRT2663xxxxx

config MCUX_HW_IP_DriverType_PDCON
    bool
    default y
    depends on MCUX_HW_DEVICE_ID_MIMXRT2663xxxxx

config MCUX_HW_IP_DriverType_PDM
    bool
    default y
    depends on MCUX_HW_DEVICE_ID_MIMXRT2663xxxxx

config MCUX_HW_IP_DriverType_POWERCON
    bool
    default y
    depends on MCUX_HW_DEVICE_ID_MIMXRT2663xxxxx

config MCUX_HW_IP_DriverType_PWM
    bool
    default y
    depends on MCUX_HW_DEVICE_ID_MIMXRT2663xxxxx

config MCUX_HW_IP_DriverType_REFORMATTER
    bool
    default y
    depends on MCUX_HW_DEVICE_ID_MIMXRT2663xxxxx

config MCUX_HW_IP_DriverType_RESETCON
    bool
    default y
    depends on MCUX_HW_DEVICE_ID_MIMXRT2663xxxxx

config MCUX_HW_IP_DriverType_ROMC
    bool
    default y
    depends on MCUX_HW_DEVICE_ID_MIMXRT2663xxxxx

config MCUX_HW_IP_DriverType_RT2K_PMU
    bool
    default y
    depends on MCUX_HW_DEVICE_ID_MIMXRT2663xxxxx

config MCUX_HW_IP_DriverType_RTC_V2
    bool
    default y
    depends on MCUX_HW_DEVICE_ID_MIMXRT2663xxxxx

config MCUX_HW_IP_DriverType_S3MU
    bool
    default y
    depends on MCUX_HW_DEVICE_ID_MIMXRT2663xxxxx

config MCUX_HW_IP_DriverType_SAI
    bool
    default y
    depends on MCUX_HW_DEVICE_ID_MIMXRT2663xxxxx

config MCUX_HW_IP_DriverType_SINC
    bool
    default y
    depends on MCUX_HW_DEVICE_ID_MIMXRT2663xxxxx

config MCUX_HW_IP_DriverType_SRAM
    bool
    default y
    depends on MCUX_HW_DEVICE_ID_MIMXRT2663xxxxx

config MCUX_HW_IP_DriverType_SRAMCTL
    bool
    default y
    depends on MCUX_HW_DEVICE_ID_MIMXRT2663xxxxx

config MCUX_HW_IP_DriverType_SRAMC_1
    bool
    default y
    depends on MCUX_HW_DEVICE_ID_MIMXRT2663xxxxx

config MCUX_HW_IP_DriverType_STM
    bool
    default y
    depends on MCUX_HW_DEVICE_ID_MIMXRT2663xxxxx

config MCUX_HW_IP_DriverType_SWT
    bool
    default y
    depends on MCUX_HW_DEVICE_ID_MIMXRT2663xxxxx

config MCUX_HW_IP_DriverType_TENBASET_PHY
    bool
    default y
    depends on MCUX_HW_DEVICE_ID_MIMXRT2663xxxxx

config MCUX_HW_IP_DriverType_TINGPU
    bool
    default y
    depends on MCUX_HW_DEVICE_ID_MIMXRT2663xxxxx

config MCUX_HW_IP_DriverType_TMR_1
    bool
    default y
    depends on MCUX_HW_DEVICE_ID_MIMXRT2663xxxxx

config MCUX_HW_IP_DriverType_TPM
    bool
    default y
    depends on MCUX_HW_DEVICE_ID_MIMXRT2663xxxxx

config MCUX_HW_IP_DriverType_TRDC_1
    bool
    default y
    depends on MCUX_HW_DEVICE_ID_MIMXRT2663xxxxx

config MCUX_HW_IP_DriverType_TRGSYNC
    bool
    default y
    depends on MCUX_HW_DEVICE_ID_MIMXRT2663xxxxx

config MCUX_HW_IP_DriverType_USBNC
    bool
    default y
    depends on MCUX_HW_DEVICE_ID_MIMXRT2663xxxxx

config MCUX_HW_IP_DriverType_USB_HOST_DEVICE_EHCI
    bool
    default y
    depends on MCUX_HW_DEVICE_ID_MIMXRT2663xxxxx

config MCUX_HW_IP_DriverType_USB_HOST_DEVICE_KHCI
    bool
    default y
    depends on MCUX_HW_DEVICE_ID_MIMXRT2663xxxxx

config MCUX_HW_IP_DriverType_USB_HSDCD
    bool
    default y
    depends on MCUX_HW_DEVICE_ID_MIMXRT2663xxxxx

config MCUX_HW_IP_DriverType_USB_PHY
    bool
    default y
    depends on MCUX_HW_DEVICE_ID_MIMXRT2663xxxxx

config MCUX_HW_IP_DriverType_USDHC
    bool
    default y
    depends on MCUX_HW_DEVICE_ID_MIMXRT2663xxxxx

config MCUX_HW_IP_DriverType_VBATCON
    bool
    default y
    depends on MCUX_HW_DEVICE_ID_MIMXRT2663xxxxx

config MCUX_HW_IP_DriverType_XBAR_DSC
    bool
    default y
    depends on MCUX_HW_DEVICE_ID_MIMXRT2663xxxxx

config MCUX_HW_IP_DriverType_XSPI
    bool
    default y
    depends on MCUX_HW_DEVICE_ID_MIMXRT2663xxxxx
```

## RT2660/MIMXRT2663/drivers/Kconfig
```kconfig
# Copyright 2025 NXP
#
# SPDX-License-Identifier: BSD-3-Clause

menu "Device specific drivers"
    rsource "./Kconfig_clock"
    rsource "./Kconfig_edma_soc"
    rsource "./Kconfig_inputmux_connections"
    rsource "./Kconfig_iomuxc"
    rsource "./Kconfig_mcm"
    rsource "./Kconfig_memcon"
    rsource "./Kconfig_memory"
    rsource "./Kconfig_mipi_dsi_soc"
    rsource "./Kconfig_modcon"
    rsource "./Kconfig_power"
    rsource "./Kconfig_resetcon"
    rsource "./Kconfig_trdc_soc"
    rsource "./Kconfig_vbatcon"
endmenu
```
